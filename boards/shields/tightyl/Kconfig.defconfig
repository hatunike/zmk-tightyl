## boards/shields/tightyl/Kconfig.defconfig
```kconfig
if SHIELD_TIGHTYL_LEFT

config ZMK_KEYBOARD_NAME
    default "Tightyl"

config ZMK_SPLIT_ROLE_CENTRAL
    default y

endif # SHIELD_TIGHTYL_LEFT

if SHIELD_TIGHTYL_LEFT || SHIELD_TIGHTYL_RIGHT

config ZMK_SPLIT
    default y

endif # SHIELD_TIGHTYL_LEFT || SHIELD_TIGHTYL_RIGHT
```
