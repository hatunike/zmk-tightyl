#include "tightyl.dtsi"

&kscan {
    col-gpios
        = <&gpio0 22 GPIO_ACTIVE_HIGH>  /* P0.22 */
        , <&gpio0 24 GPIO_ACTIVE_HIGH>  /* P0.24 */
        , <&gpio1 0  GPIO_ACTIVE_HIGH>  /* P1.00 */
        , <&gpio0 11 GPIO_ACTIVE_HIGH>  /* P0.11 */
        , <&gpio1 4  GPIO_ACTIVE_HIGH>  /* P1.04 */
        , <&gpio1 6  GPIO_ACTIVE_HIGH>  /* P1.06 */
        ;
};
